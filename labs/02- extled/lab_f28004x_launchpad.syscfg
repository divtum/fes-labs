/**
 *
 * @cliArgs --board "/boards/LAUNCHXL_F280049C" --device "F28004x" --part "F28004x_100PZ" --package "F28004x_100PZ" --context "system" --product "C2000WARE@26.01.00.00"
 * @versions {"tool":"1.28.0+4696"}
 */

/**
 * Import the modules used in this configuration.
 */
const gpio  = scripting.addModule("/driverlib/gpio.js", {}, false);
const gpio1 = gpio.addInstance();
const gpio2 = gpio.addInstance();
const gpio3 = gpio.addInstance();

/**
 * Write custom configuration values to the imported modules.
 */
gpio1.$name           = "Button_GPIO";
gpio1.gpioPin.$assign = "boosterpack1.33";

gpio2.direction = "GPIO_DIR_MODE_OUT";
gpio2.$name     = "LED_GPIO";
gpio2.$hardware = system.deviceData.board.components.LED4;

gpio3.$name     = "LED1_GPIO";
gpio3.direction = "GPIO_DIR_MODE_OUT";
gpio3.$hardware = system.deviceData.board.components.LED5;

/**
 * Pinmux solution for unlocked pins/peripherals. This ensures that minor changes to the automatic solver in a future
 * version of the tool will not impact the pinmux you originally saw.  These lines can be completely deleted in order to
 * re-solve from scratch.
 */
gpio2.gpioPin.$suggestSolution = "boosterpack1.12";
gpio3.gpioPin.$suggestSolution = "boosterpack2.52";
